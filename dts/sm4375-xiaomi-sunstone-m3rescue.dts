// SPDX-License-Identifier: BSD-3-Clause
/*
 * M3 tree with sunstone.rescue on the command line: init-m3 stays in the initramfs (dropbear on
 * 192.168.7.2) instead of booting userdata. Packed with the M3 kernel: KSTAGE=m3 tools/mkboot.sh m3rescue
 */
#include "sm4375-xiaomi-sunstone-m3.dts"

/ {
	chosen {
		bootargs = "console=tty0 ignore_loglevel printk.devkmsg=on panic=20 reboot=warm rdinit=/init clk_ignore_unused pd_ignore_unused sunstone.rescue";
	};
};
